## buildroot/Config.in
```kconfig
source "$BR2_EXTERNAL_NEST_PATH/package/connman-nest/Config.in"
source "$BR2_EXTERNAL_NEST_PATH/package/iptables-legacy/Config.in"
source "$BR2_EXTERNAL_NEST_PATH/package/ti-compat/Config.in"
source "$BR2_EXTERNAL_NEST_PATH/package/ti-wl12xx-compat/Config.in"
source "$BR2_EXTERNAL_NEST_PATH/package/ti-wl12xx-driver/Config.in"
```

## buildroot/configs/j49_defconfig
```kconfig
BR2_arm=y
BR2_cortex_a8=y
BR2_ARM_FPU_NEON=y
BR2_TOOLCHAIN_EXTERNAL=y
BR2_TOOLCHAIN_EXTERNAL_CUSTOM=y
BR2_TOOLCHAIN_EXTERNAL_PATH="/home/josh/Toolchains/arm-nest-linux-gnueabihf"
BR2_TOOLCHAIN_EXTERNAL_CUSTOM_PREFIX="arm-nest-linux-gnueabihf"
BR2_TOOLCHAIN_EXTERNAL_GCC_4_8=y
BR2_TOOLCHAIN_EXTERNAL_CUSTOM_GLIBC=y
BR2_TOOLCHAIN_EXTERNAL_CXX=y
BR2_PACKAGE_OVERRIDE_FILE="$(BR2_EXTERNAL_NEST_PATH)/local.mk"
BR2_ROOTFS_DEVICE_CREATION_DYNAMIC_MDEV=y
BR2_ROOTFS_DEVICE_TABLE="$(BR2_EXTERNAL_NEST_PATH)/board/nest/j49/device_table.txt"
BR2_ROOTFS_OVERLAY="$(BR2_EXTERNAL_NEST_PATH)/board/nest/j49/rootfs_overlay"
BR2_LINUX_KERNEL=y
BR2_LINUX_KERNEL_CUSTOM_VERSION=y
BR2_LINUX_KERNEL_CUSTOM_VERSION_VALUE="2.6.37"
BR2_LINUX_KERNEL_USE_CUSTOM_CONFIG=y
BR2_LINUX_KERNEL_CUSTOM_CONFIG_FILE="$(BR2_EXTERNAL_NEST_PATH)/board/nest/j49/linux.config"
BR2_LINUX_KERNEL_UIMAGE=y
BR2_LINUX_KERNEL_LZMA=y
BR2_PACKAGE_BUSYBOX_CONFIG="$(BR2_EXTERNAL_NEST_PATH)/board/nest/j49/busybox.config"
BR2_PACKAGE_MTD=y
BR2_PACKAGE_MTD_MKFSJFFS2=y
BR2_PACKAGE_MTD_MTDPART=y
BR2_PACKAGE_LIBUBOOTENV=y
BR2_PACKAGE_TI_UTILS=y
BR2_PACKAGE_DNSMASQ=y
BR2_PACKAGE_DROPBEAR=y
BR2_PACKAGE_WIRELESS_TOOLS=y
BR2_PACKAGE_WPA_SUPPLICANT=y
BR2_PACKAGE_WPA_SUPPLICANT_WEXT=y
BR2_PACKAGE_WPA_SUPPLICANT_AUTOSCAN=y
BR2_PACKAGE_WPA_SUPPLICANT_EAP=y
BR2_PACKAGE_WPA_SUPPLICANT_DEBUG_SYSLOG=y
BR2_PACKAGE_WPA_SUPPLICANT_DBUS=y
BR2_TARGET_ROOTFS_CPIO=y
BR2_TARGET_ROOTFS_CPIO_UIMAGE=y
BR2_TARGET_ROOTFS_JFFS2=y
BR2_TARGET_ROOTFS_JFFS2_NANDFLASH_128K=y
BR2_PACKAGE_CONNMAN_NEST=y
BR2_PACKAGE_TI_WL12XX_COMPAT=y
```

## buildroot/package/connman-nest/Config.in
```kconfig
config BR2_PACKAGE_CONNMAN_NEST
	bool "connman-nest"
	select BR2_PACKAGE_DBUS
	select BR2_PACKAGE_LIBGLIB2
	select BR2_PACKAGE_IPTABLES_LEGACY
	select BR2_PACKAGE_READLINE
	depends on BR2_USE_WCHAR # libglib2
	depends on BR2_TOOLCHAIN_HAS_THREADS # dbus, libglib2
	depends on BR2_USE_MMU # dbus, libglib2
	depends on !BR2_STATIC_LIBS # needs dlopen()
	help
	  The Connection Manager (ConnMan) project provides a daemon
	  for managing internet connections within embedded devices
	  running the Linux operating system.

	  Built from Nest Thermostat repo
	  https://nest-open-source.googlesource.com/nest-learning-thermostat/5.9.4/connman

comment "connman needs a toolchain w/ wchar, threads, resolver, dynamic library"
	depends on BR2_USE_MMU
	depends on !BR2_USE_WCHAR || !BR2_TOOLCHAIN_HAS_THREADS || BR2_STATIC_LIBS
```

## buildroot/package/ti-wl12xx-compat/Config.in
```kconfig
config BR2_PACKAGE_TI_WL12XX_COMPAT
	bool "wl12xx TI compat-wireless drivers"
	depends on BR2_LINUX_KERNEL
	select BR2_PACKAGE_TI_WL12XX_DRIVER
	select BR2_PACKAGE_TI_COMPAT
	help
	  Builds wl12xx out-of-tree drivers from TI-OpenLink repos.
```
